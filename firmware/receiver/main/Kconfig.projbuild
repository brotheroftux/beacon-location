## firmware/receiver/main/Kconfig.projbuild
```kconfig
menu "WiFi Configuration"
    config RECEIVER_WIFI_SSID
        string "SSID"

    config RECEIVER_WIFI_PASSWORD
        string "Password"
endmenu

menu "Location Service Sync Configuration"
    config RECEIVER_EVTDUMP_ENDPOINT
        string "Endpoint to dump events to"
endmenu
```

## firmware/receiver/sdkconfig.defaults
```kconfig
CONFIG_BT_ENABLED=y
CONFIG_BT_BLUEDROID_ENABLED=n
CONFIG_BT_NIMBLE_ENABLED=y
CONFIG_BTDM_CTRL_MODE_BLE_ONLY=y
CONFIG_BTDM_CTRL_MODE_BR_EDR_ONLY=n
CONFIG_BTDM_CTRL_MODE_BTDM=n
CONFIG_HEAP_ABORT_WHEN_ALLOCATION_FAILS=y
```
